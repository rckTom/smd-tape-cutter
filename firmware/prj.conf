## CMakeLists.txt
```
cmake_minimum_required(VERSION 3.13.1)

set(DTS_ROOT ${CMAKE_CURRENT_LIST_DIR})
set(DTC_OVERLAY_FILE ${CMAKE_CURRENT_LIST_DIR}/stepper_config.overlay)

find_package(Zephyr REQUIRED HINTS $ENV{ZEPHYR_BASE})
project(zerhacker)

target_sources(app PRIVATE src/main.c
                           src/stepper.c
                           src/zerhacker.c
                           src/shell.c)
```

## prj.conf
```kconfig
CONFIG_SYS_CLOCK_TICKS_PER_SEC=10000
CONFIG_FPU=y
CONFIG_GPIO=y
CONFIG_NEWLIB_LIBC=y
CONFIG_SHELL=y
CONFIG_SHELL_LOG_BACKEND=y
CONFIG_LOG=y
```

## stepper_config.overlay
```dts
/ {
    steppers {
        compatible = "steppers";

        stepper_cutter: stepper_cutter {
            enable-gpios = <&gpioa 10 0>;
            dir-gpios = <&gpiob 3 0>;
            step-gpios = <&gpiob 5 0>;
        };

        stepper_mover: stepper_mover {
            enable-gpios = <&gpiob 4 0>;
            dir-gpios = <&gpiob 10 0>;
            step-gpios = <&gpioa 8 0>;
        };
    };
};
```

## dts/bindings/steppers.yaml
```yaml
compatible: "steppers"
description: "Device tree node representing a stepper"

child-binding:
  description: Stepper child node
  properties:
    dir-gpios:
      type: phandle-array
      required: true
    step-gpios:
      type: phandle-array
      required: true
    enable-gpios:
      type: phandle-array
      required: true
```

## src/main.c
```c
/*
 * smd tape cutter
 *
 * Copyright (c) Thomas Schmid, 2021
 *
 * Authors:
 *  Thomas Schmid <tom@lfence.de>
 *
 * This work is licensed under the terms of the GNU GPL, version 3.  See
 * the LICENSE file in the top-level directory.
 */

#include <zephyr.h>
#include <device.h>
#include <devicetree.h>
#include <drivers/gpio.h>
#include <logging/log.h>
#include <math.h>
#include <stdio.h>
#include <shell/shell.h>
#include "stepper.h"
#include "zerhacker.h"

LOG_MODULE_REGISTER(zerhacker, CONFIG_LOG_DEFAULT_LEVEL);

void main(void)
{
	stepper_init(&stepper_1);
	stepper_init(&stepper_2);

	stepper_enable(&stepper_2, true);
	stepper_enable(&stepper_1, true);

	home_cutter();

	while (1) {
		k_msleep(1000);
	}
}
```

## src/shell.c
```c
/*
 * smd tape cutter
 *
 * Copyright (c) Thomas Schmid, 2021
 *
 * Authors:
 *  Thomas Schmid <tom@lfence.de>
 *
 * This work is licensed under the terms of the GNU GPL, version 3.  See
 * the LICENSE file in the top-level directory.
 */

#include "zerhacker.h"
#include <logging/log.h>
#include <shell/shell.h>
#include <stdlib.h>

LOG_MODULE_DECLARE(zerhacker);

static int shell_stepper_move_abs(const struct shell *shell,
				  size_t argc,
				  char **argv)
{
	int id = strtol(*(argv + 1), NULL, 10);
	int pos = strtol(*(argv + 2), NULL, 10);

	if (id < 1 || id > 2) {
		LOG_ERR("stepper id not supported");
		return -1;
	}

	struct stepper *stepper;

	if (id == 1) {
		stepper = &stepper_1;
	} else if (id == 2) {
		stepper = &stepper_2;
	}

	stepper_move(stepper, pos);
	return 0;
}

static int shell_stepper_move_rel(const struct shell *shell,
				  size_t argc,
				  char **argv)
{
	int id = strtol(*(argv + 1), NULL, 10);
	int pos = strtol(*(argv + 2), NULL, 10);

	if (id < 1 || id > 2) {
		LOG_ERR("stepper id not supported");
		return -1;
	}

	struct stepper *stepper;

	if (id == 1) {
		stepper = &stepper_1;
	} else if (id == 2) {
		stepper = &stepper_2;
	}

	stepper_move(stepper, stepper->cur_pos + pos);
	return 0;
}

static int shell_hacker_job(const struct shell *shell, int argc, char **argv)
{
	int length = strtol(*(argv + 1), NULL, 10);
	int count = strtol(*(argv + 2), NULL, 10);

	float pos = 0;

	stepper_2.cur_pos = 0;
	cutter_up();

	for (; count > 0; count--) {
		pos += 800.f / 30.f * length;
		stepper_move(&stepper_2, (int64_t) pos);
		cut();
	}

	return 0;
}

static int shell_disable_stepper(const struct shell *shell,
				 int argc,
				 char **argv)
{
	stepper_enable(&stepper_1, false);
	stepper_enable(&stepper_2, false);

	return 0;
}

static int shell_move_knife(const struct shell *shell, int argc, char **argv)
{
	const char *in = *(argv + 1);

	if (strcmp(in, "up") == 0) {
		cutter_up();
	} else if (strcmp(in, "down") == 0) {
		cutter_down();
	} else {
		return -1;
	}

	return 0;
}

SHELL_STATIC_SUBCMD_SET_CREATE(sub_hacker,
			       SHELL_CMD_ARG(move_rel, NULL,
					     "move stepper. arg1: stepper number, arg2: position",
					     shell_stepper_move_rel, 3,
					     0),
			       SHELL_CMD_ARG(move_abs, NULL,
					     "move to absolute coordinates. arg1: stepper number, arg2: position",
					     shell_stepper_move_abs, 3, 0),
			       SHELL_CMD_ARG(knife, NULL,
					     "position knife. arg1: up or down",
					     shell_move_knife, 2, 0),
			       SHELL_CMD_ARG(hack, NULL,
					     "do job. arg1: length, arg2: amount ",
					     shell_hacker_job, 3, 0),
			       SHELL_CMD_ARG(disable_stepper, NULL,
					     "disable all steppers",
					     shell_disable_stepper, 1, 0),
			       SHELL_SUBCMD_SET_END
			       );

SHELL_CMD_REGISTER(hacker, &sub_hacker, "hacker control", NULL);
```

## src/stepper.c
```c
/*
 * smd tape cutter
 *
 * Copyright (c) Thomas Schmid, 2021
 *
 * Authors:
 *  Thomas Schmid <tom@lfence.de>
 *
 * This work is licensed under the terms of the GNU GPL, version 3.  See
 * the LICENSE file in the top-level directory.
 */

#include "stepper.h"
#include <stdlib.h>
#include <math.h>
#include <drivers/gpio.h>
#include <logging/log.h>

LOG_MODULE_DECLARE(zerhacker);

static int stepper_set_dir(const struct stepper *stepper, bool dir)
{
	int rc = gpio_pin_set(stepper->dir_dev, stepper->dir_pin, dir);

	if (rc != 0) {
		LOG_ERR("unable to set direciton pin");
		return -1;
	}

	return 0;
}

int stepper_enable(const struct stepper *stepper, bool enable)
{
	int rc = gpio_pin_set(stepper->enable_dev, stepper->enable_pin, enable);

	if (rc != 0) {
		LOG_ERR("unable to set enable pin");
		return -1;
	}

	return 0;
}

void stepper_move(struct stepper *stepper, int64_t target)
{
	struct ramp_info *ramp = &stepper->ramp;

	stepper->target_pos = target;
	int64_t steps = target - stepper->cur_pos;

	ramp->dir = steps >= 0;

	stepper_set_dir(stepper, ramp->dir);

	ramp->num_steps = abs(steps);
	ramp->acc_counter = 0;
	ramp->step_counter = 0;

	// calculate limits
	uint64_t s_alim = ramp->num_steps / 2;
	uint64_t s_vlim = stepper->max_v * stepper->max_v / stepper->max_accel;

	if (s_vlim < s_alim) {
		ramp->accel_steps = s_vlim;
	} else {
		ramp->accel_steps = s_alim;
	}
	// initial time delay
	uint64_t dt0 = sqrt(2.0f / stepper->max_accel) * 1000000.f;

	ramp->us = dt0;
	ramp->dt0 = dt0;

	stepper_enable(stepper, true);
	stepper->moving = true;
	k_timer_start(&stepper->timer, K_USEC(dt0), K_NO_WAIT);

	while (stepper->moving) {
		k_msleep(100);
	}
}

static void disable_step_pin(struct k_work *work)
{
	struct stepper *stepper = CONTAINER_OF(work, struct stepper, work);

	gpio_pin_set(stepper->step_dev, stepper->step_pin, 0);
}

void timer_clbk(struct k_timer *timer)
{
	struct stepper *stepper = CONTAINER_OF(timer, struct stepper, timer);
	struct ramp_info *ramp = &stepper->ramp;

	if (stepper->cur_pos == stepper->target_pos) {
		stepper->moving = false;
		return;
	}

	// do step
	gpio_pin_toggle(stepper->step_dev, stepper->step_pin);
	k_delayed_work_init(&stepper->work, disable_step_pin);
	k_delayed_work_submit(&stepper->work, K_USEC(10));

	ramp->step_counter++;
	if (ramp->dir) {
		stepper->cur_pos++;
	} else {
		stepper->cur_pos--;
	}

	if (ramp->step_counter <= ramp->accel_steps) {
		ramp->us = ramp->dt0 *
			   (sqrtf((ramp->step_counter + 1.0f)) -
			    sqrtf(ramp->step_counter));
	} else if (ramp->num_steps - ramp->step_counter > ramp->accel_steps) {
		// coast at constant speed
	} else {
		uint64_t rem = ramp->num_steps - ramp->step_counter;
		ramp->us = ramp->dt0 * (sqrtf((rem + 1.0f)) - sqrtf(rem));
	}

	k_timer_start(timer, K_USEC(ramp->us), K_NO_WAIT);
}

int stepper_init(struct stepper *stepper)
{
	int rc;

	stepper->enable_dev = device_get_binding(stepper->enable_node);
	stepper->dir_dev = device_get_binding(stepper->dir_node);
	stepper->step_dev = device_get_binding(stepper->step_node);

	if (stepper->enable_dev == NULL ||
	    stepper->dir_dev == NULL ||
	    stepper->step_dev == NULL) {
		LOG_ERR("unable to initialize stepper. Can not get gpio devs");
		return -1;
	}

	rc = gpio_pin_configure(stepper->enable_dev,
				stepper->enable_pin,
				GPIO_OUTPUT | GPIO_ACTIVE_LOW);

	if (rc != 0) {
		goto configure_error;
	}

	rc = gpio_pin_configure(stepper->dir_dev,
				stepper->dir_pin,
				GPIO_OUTPUT | GPIO_ACTIVE_HIGH);

	if (rc != 0) {
		goto configure_error;
	}

	rc = gpio_pin_configure(stepper->step_dev,
				stepper->step_pin,
				GPIO_OUTPUT | GPIO_ACTIVE_HIGH);

	if (rc != 0) {
		goto configure_error;
	}

	k_timer_init(&stepper->timer, timer_clbk, NULL);

	return 0;

configure_error:
	LOG_ERR("unable to configure stepper gpios");
	return rc;
}
```

## src/stepper.h
```c
/*
 * smd tape cutter
 *
 * Copyright (c) Thomas Schmid, 2021
 *
 * Authors:
 *  Thomas Schmid <tom@lfence.de>
 *
 * This work is licensed under the terms of the GNU GPL, version 3.  See
 * the LICENSE file in the top-level directory.
 */

#ifndef ZERHACKER_STEPPER__H
#define ZERHACKER_STEPPER__H

#include <stdint.h>
#include <stdbool.h>
#include <zephyr.h>

struct ramp_info {
	uint64_t accel_steps;
	uint64_t num_steps;

	uint64_t acc_counter;
	uint64_t step_counter;

	bool dir;
	uint64_t us;
	uint64_t dt0;
};

struct stepper {
	bool moving;
	const char *enable_node;
	const char *dir_node;
	const char *step_node;
	const int enable_pin;
	const int dir_pin;
	const int step_pin;

	int64_t cur_pos, target_pos;

	float max_v, max_accel;

	struct k_delayed_work work;
	struct k_timer timer;

	const struct device *enable_dev;
	const struct device *dir_dev;
	const struct device *step_dev;

	struct ramp_info ramp;
};

void stepper_move(struct stepper *stepper, int64_t target);
int stepper_init(struct stepper *stepper);
int stepper_enable(const struct stepper *stepper, bool enable);

#endif
```

## src/zerhacker.c
```c
/*
 * smd tape cutter
 *
 * Copyright (c) Thomas Schmid, 2021
 *
 * Authors:
 *  Thomas Schmid <tom@lfence.de>
 *
 * This work is licensed under the terms of the GNU GPL, version 3.  See
 * the LICENSE file in the top-level directory.
 */

#include "zerhacker.h"
#include "devicetree.h"

#define STEPPER_MOVER DT_NODELABEL(stepper_mover)
#define STEPPER_CUTTER DT_NODELABEL(stepper_cutter)

struct stepper stepper_1 = {
	.enable_node = DT_GPIO_LABEL(STEPPER_CUTTER, enable_gpios),
	.dir_node = DT_GPIO_LABEL(STEPPER_CUTTER, dir_gpios),
	.step_node = DT_GPIO_LABEL(STEPPER_CUTTER, step_gpios),
	.enable_pin = DT_GPIO_PIN(STEPPER_CUTTER, enable_gpios),
	.dir_pin = DT_GPIO_PIN(STEPPER_CUTTER, dir_gpios),
	.step_pin = DT_GPIO_PIN(STEPPER_CUTTER, step_gpios),
	.max_accel = 8000.0,
	.max_v = 2000.0,
};

struct stepper stepper_2 = {
	.enable_node = DT_GPIO_LABEL(STEPPER_MOVER, enable_gpios),
	.dir_node = DT_GPIO_LABEL(STEPPER_MOVER, dir_gpios),
	.step_node = DT_GPIO_LABEL(STEPPER_MOVER, step_gpios),
	.enable_pin = DT_GPIO_PIN(STEPPER_MOVER, enable_gpios),
	.dir_pin = DT_GPIO_PIN(STEPPER_MOVER, dir_gpios),
	.step_pin = DT_GPIO_PIN(STEPPER_MOVER, step_gpios),
	.max_accel = 8000.0,
	.max_v = 2000.0,
};

void cut()
{

	int64_t d1 = abs(-10 - stepper_1.cur_pos);
	int64_t d2 = abs(-460 - stepper_1.cur_pos);

	if (d1 > d2) {
		stepper_move(&stepper_1, -10);
	} else {
		stepper_move(&stepper_1, -460);
	}
}

void cutter_down()
{
	stepper_move(&stepper_1, -230);
}

void cutter_up()
{
	int64_t d1 = abs(-10 - stepper_1.cur_pos);
	int64_t d2 = abs(-460 - stepper_1.cur_pos);

	if (d1 > d2) {
		stepper_move(&stepper_1, -460);
	} else {
	stepper_move(&stepper_1, -10);
	}
}

void home_cutter()
{
	float old_speed = stepper_1.max_v;

	stepper_1.max_v = 50;
	stepper_move(&stepper_1, 450);
	stepper_1.cur_pos = 0;
	stepper_move(&stepper_1, -10);
	stepper_1.max_v = old_speed;
}
```

## src/zerhacker.h
```c
/*
 * smd tape cutter
 *
 * Copyright (c) Thomas Schmid, 2021
 *
 * Authors:
 *  Thomas Schmid <tom@lfence.de>
 *
 * This work is licensed under the terms of the GNU GPL, version 3.  See
 * the LICENSE file in the top-level directory.
 */

#ifndef ZERHACKER_ZERHACKER__H
#define ZERHACKER_ZERHACKER__H

#include "stepper.h"

extern struct stepper stepper_1;
extern struct stepper stepper_2;

void cut();
void cutter_up();
void cutter_down();
void home_cutter();

#endif
```
